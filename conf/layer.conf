## conf/layer.conf
```bitbake
BBPATH := "${BBPATH}:${LAYERDIR}" 

BBFILES := "${BBFILES} ${LAYERDIR}/recipes-*/*/*.bb \ 
           ${LAYERDIR}/recipes-*/*/*.bbappend \
	   ${LAYERDIR}/images/*.bb*"


BBFILE_COLLECTIONS += "gyroidos-riscv"
BBFILE_PATTERN_gyroidos-riscv := "^${LAYERDIR}/"
BBFILE_PRIORITY_gyroidos-riscv := "7"

LAYERDEPENDS_gyroidos-riscv = "gyroidos-layer"

LAYERSERIES_COMPAT_gyroidos-riscv += "kirkstone"
```

## conf/machine/qemuriscv64.conf
```bitbake
KERNEL_IMAGETYPE = "Image"
KERNEL_IMAGETYPES_remove = "uImage"
EXTRA_IMAGEDEPENDS_remove = "opensbi"
```
